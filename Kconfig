## Kconfig
```kconfig
mainmenu "SPIRIT OS build configuration"

config KAS_INCLUDE_COMMON
    string
    default "/repo/kas.yml"
    help
      This file is automatically included in the kas build.
      It contains essential base configuration.

source "kas/machine/Kconfig"
source "kas/target/Kconfig"
source "kas/packages/Kconfig"
source "kas/features/Kconfig"
```

## conf/distro/spirit-os.conf
```bitbake
DISTRO_NAME = "SPIRIT OS"
DISTRO_VERSION = "0.1"

INIT_MANAGER = "systemd"

# If SPIRIT_DEV_MODE enabled, add development features
# Default to production
SPIRIT_DEV_MODE ?= "0"
OVERRIDES .= ":${@'spirit-dev' if d.getVar('SPIRIT_DEV_MODE') == '1' else ''}"

ENABLE_UART:spirit-phone-cm5:spirit-dev = "1"
SERIAL_CONSOLES:spirit-phone-cm5:spirit-dev = "115200;ttyAMA0"
IMAGE_INSTALL:append:spirit-phone-cm5:spirit-dev = " sysvinit-inittab"
RPI_EXTRA_CONFIG:spirit-phone-cm5:spirit-dev = "dtoverlay=uart0"
EXTRA_IMAGE_FEATURES:append:spirit-dev = " empty-root-password"
EXTRA_USERS_PARAMS:spirit-dev = "usermod -P '' root"

# Automatically delete intermediate build workdirs after packaging to save disk space, exclude the kernel recipes
INHERIT += "rm_work"
RM_WORK_EXCLUDE += "linux-yocto linux-raspberrypi virtual/kernel"

# Disable H.264 codec due to errors. TODO investigate
PACKAGECONFIG:remove:pn-ffmpeg = "x264"

# Disable Guarded Control Stack (GCS) due to KDE Framework 6 layer not having support. TODO investigate
TARGET_CFLAGS:append:aarch64 = " -mbranch-protection=pac-ret+leaf"
TARGET_CXXFLAGS:append:aarch64 = " -mbranch-protection=pac-ret+leaf"
TARGET_LDFLAGS:append:aarch64 = " -Wl,-z,notext"
```

## conf/layer.conf
```bitbake
# We have a conf and classes directory, add to BBPATH
BBPATH .= ":${LAYERDIR}"

# We have recipes-* directories, add to BBFILES
BBFILES += "${LAYERDIR}/recipes-*/*/*.bb \
            ${LAYERDIR}/recipes-*/*/*.bbappend"

BBFILE_COLLECTIONS += "spirit"
BBFILE_PATTERN_spirit = "^${LAYERDIR}/"
BBFILE_PRIORITY_spirit = "10"

LAYERSERIES_COMPAT_spirit = "scarthgap"
LAYERDEPENDS_spirit = "core"
```

## conf/machine/spirit-phone-cm5.conf
```bitbake
require conf/machine/raspberrypi5.conf

MACHINEOVERRIDES =. "spirit-phone-cm5:"

# The CM5 kernel repo uses bcm2712_defconfig
KBUILD_DEFCONFIG = "bcm2712_defconfig"

IMAGE_FSTYPES = "wic.bz2 wic.bmap"

# Take a look at https://git.yoctoproject.org/meta-raspberrypi/tree/docs/ipcompliance.md
LICENSE_FLAGS_ACCEPTED += "synaptics-killswitch"
```

## kas/machine/Kconfig
```kconfig
# Submenu for selecting MACHINE
menu "Select MACHINE"

choice
    prompt "Choose your target machine"
    default KCONF_MACHINE_CM5
    help
      Pick the machine hardware configuration for the build.
      For more information see - https://docs.yoctoproject.org/ref-manual/variables.html#term-MACHINE

config KCONF_MACHINE_CM5
    bool "spirit-phone-cm5"
    help
      Build for the Spirit Phone CM5 device.

config KCONF_MACHINE_QEMU
    bool "qemuarm64"
    help
      Build for the QEMU ARM64 emulator.

endchoice

config MACHINE
    string
    default "spirit-phone-cm5" if KCONF_MACHINE_CM5
    default "qemuarm64" if KCONF_MACHINE_QEMU

endmenu
```

## kas/target/Kconfig
```kconfig
# Submenu for selecting TARGET
menu "Select build target"

choice
    prompt "Choose target image"
    default KCONF_TARGET_MINIMAL
    help
      Select the image target for `kas build` invocation. From shell it can be started as `bitbake <target>`.
      For more info see - https://docs.yoctoproject.org/ref-manual/images.html#images

config KCONF_TARGET_MINIMAL
    bool "Minimal GUI-less (core-image-minimal)"
    help
      Small image, fastest builds. Best for kernel and driver work.

config KCONF_TARGET_PLASMA
    bool "Plasma Mobile demo system (core-image-plasma-mobile)"
    help
      Full GUI stack for UI and app experimentation.

endchoice

# Map KCONF_TARGET to a kas YAML to include
config KAS_INCLUDE_TARGET
    string
    default "/repo/kas/target/core-image-minimal.yml" if KCONF_TARGET_MINIMAL
    default "/repo/kas/target/core-image-plasma-mobile.yml" if KCONF_TARGET_PLASMA
    help
      Selected image target for `kas build` invocation. From shell it can be started as `bitbake <target>`.
      For more info see - https://docs.yoctoproject.org/ref-manual/images.html#images

endmenu
```
